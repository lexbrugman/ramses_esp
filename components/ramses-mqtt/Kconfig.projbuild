## components/ramses-mqtt/Kconfig.projbuild
```kconfig
menu "MQTT Configuration"

    config MQTT_LOG_LEVEL
        int "MQTT LOG LEVEL"
        range 0	5
        default 2
        help
        	Set LOG Level for MQTT module
        	0=None
        	1=Error
        	2=Warn
        	3=Info
        	4=Debug
        	5=Verbose
        	
    
    config MQTT_ROOT
        string "MQTT Root topic"
        default "RAMSES/GATEWAY"
        help
          "Root topic for RAMSES Gateway devices"

    config MQTT_HA_DISCOVERY_PREFIX
        string "Home Assistant discovery prefix"
        default "homeassistant"
        help
          "Topic prefix Home Assistant's MQTT integration watches for discovery messages"

endmenu
```
